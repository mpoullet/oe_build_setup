## local/conf/local.conf
```bitbake
# Distribution & Machine
DISTRO = "angstrom-2008.1"
MACHINE = "beagleboard"

# Locale
ENABLE_BINARY_LOCALE_GENERATION = "0"

# SMP Support
BB_NUMBER_THREADS = "4"
PARALLEL_MAKE = "-j 4"

# TI Tools
TITOOLSDIR = "${OE_HOME}/opt/ti-tools"
TIBIOSDIR = "bios_5_33_02"
TIXDCTOOLSDIR = "xdctools_3_10_03"
TICGTOOLSDIR = "cg6x_6_0_21"

# packaged-staging
INHERIT += "packaged-staging"

# Terminal
TERMCMD = "${XTERM_TERMCMD}"
TERMCMDRUN = "${XTERM_TERMCMDRUN}"

# Directories structure
TMPDIR = "${OE_HOME}/tmp"
DL_DIR = "${OE_HOME}/sources"
# DEPLOY_DIR = "${OE_HOME}/archives"
# DEPLOY_DIR_PSTAGE = "${DEPLOY_DIR}/pstage"

# Working copies
```
